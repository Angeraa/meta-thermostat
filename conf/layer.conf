## conf/layer.conf
```bitbake
# We have a conf and classes directory, add to BBPATH
BBPATH .= ":${LAYERDIR}"

# We have recipes-* directories, add to BBFILES
BBFILES += "${LAYERDIR}/recipes-*/*/*.bb \
            ${LAYERDIR}/recipes-*/*/*.bbappend"

BBFILE_COLLECTIONS += "meta-thermostat"
BBFILE_PATTERN_meta-thermostat = "^${LAYERDIR}/"
BBFILE_PRIORITY_meta-thermostat = "6"

LAYERDEPENDS_meta-thermostat = "core"
LAYERSERIES_COMPAT_meta-thermostat = "walnascar"
```
